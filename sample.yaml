## sample.yaml
```yaml
sample:
  name: ADC devicetree driver sample
common:
  tags:
    - adc
  depends_on: adc
  filter: dt_node_has_prop("/zephyr,user","io-channels")

tests:
  sample.drivers.adc.adc_dt:
    platform_allow:
      - disco_l475_iot1
    harness: console
    timeout: 10
    harness_config:
      type: multi_line
      regex:
        - "ADC reading\\[\\d+\\]:"
        - "- .+, channel \\d+: -?\\d+"
```
