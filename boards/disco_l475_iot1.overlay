
/ {
	zephyr,user {
		io-channels = <&adc1 14>;
	};
};

&adc1 {
	#address-cells = <1>;
	#size-cells = <0>;

	channel@14 {
		reg = <14>;
		zephyr,gain = "ADC_GAIN_1";
		zephyr,reference = "ADC_REF_INTERNAL";
		zephyr,acquisition-time = <ADC_ACQ_TIME_DEFAULT>;
		zephyr,resolution = <12>;
	};
};
